## components/display/Kconfig
```kconfig
menu "CoffeeProbe display"

    choice PROBE_OLED_CONTROLLER
        prompt "OLED controller"
        default PROBE_OLED_SSD1306
        help
            The controller is fixed at build time until settings are available
            (D-008). Issue #3 identifies which controller is on the board.

        config PROBE_OLED_SSD1306
            bool "SSD1306 (0.96 inch)"

        config PROBE_OLED_SH1106
            bool "SH1106 (1.3 inch)"
    endchoice

endmenu
```

## components/thermocouple/Kconfig
```kconfig
menu "CoffeeProbe thermocouple"

    choice PROBE_TC_CHIP
        prompt "Thermocouple converter"
        default PROBE_TC_MAX31855

        config PROBE_TC_MAX31855
            bool "MAX31855"

        config PROBE_TC_MAX6675
            bool "MAX6675"
    endchoice

    config PROBE_TC_GROUNDED
        bool "Grounded probe (MAX31855)"
        default n
        help
            Enable only for a probe tip that touches the grounded roaster body.
            In this mode a short to ground is accepted, so a crushed cable that
            shorts both leads to grounded metal is NOT detected and reads close to
            the electronics temperature. This and the converter choice are the
            factory default; the settings menu overrides them (D-012).

endmenu
```

## main/Kconfig.projbuild
```kconfig
menu "CoffeeProbe fault tests"

    choice PROBE_FAULT_TEST
        prompt "Deliberate fault (test builds only)"
        default PROBE_FAULT_TEST_NONE
        help
            For the fault-injection session (#26): makes the probe fail on purpose once,
            30 s after power-on, to check that it restarts by itself and shows the reason on
            the Diagnostics screen and in the boot log. It does not fault again right after its
            own restart (so the reason can be read), only after a power-on or another restart. Never in committed defaults (guards.sh).
            Build one with: scripts/flash.sh --fault hang (or crash).

        config PROBE_FAULT_TEST_NONE
            bool "None (normal firmware)"

        config PROBE_FAULT_TEST_HANG
            bool "Freeze: the health task stops feeding the watchdog"
            help
                Expected: task watchdog panic about 5 s later, reboot, Diagnostics shows
                "Last reset: Freeze".

        config PROBE_FAULT_TEST_CRASH
            bool "Crash: the health task aborts"
            help
                Expected: panic, coredump, reboot, Diagnostics shows "Last reset: Crash" and
                "Crash record: Saved".
    endchoice

endmenu
```
